## platforms/esp-idf/m5_pocket_app/Kconfig
```kconfig
menu "M5 PocketJS application host"

    choice M5_POCKET_APP_MODE
        prompt "Application mode"
        default M5_POCKET_APP_MODE_JS
        help
            JS compiles the application to a bundle that runs in the QuickJS
            guest. AOT compiles the same sources with MicroTS into a Rust
            static library. The program's top-level CMakeLists.txt reads this
            choice before component discovery (components.cmake); change it in
            sdkconfig.defaults or menuconfig, then reconfigure.

        config M5_POCKET_APP_MODE_JS
            bool "JS: bundle in the QuickJS guest"

        config M5_POCKET_APP_MODE_AOT
            bool "AOT: MicroTS-compiled Rust static library"
    endchoice

    config M5_POCKET_APP_TASK_STACK
        int "App task stack bytes"
        default 65536
        help
            Stack of the task that runs the runtime, the guest or the compiled
            application, and the program's frame hooks. The JS guest's stack
            limit (m5_pocket_app_config.js_stack_limit) must stay below it.

    config M5_POCKET_APP_TASK_PRIORITY
        int "App task priority"
        default 5

    config M5_POCKET_APP_INTERNAL_STACK
        int "Internal-stack helper task stack bytes"
        default 8192
        help
            Stack of the helper task the host starts when the app task's
            stack is in PSRAM (m5_pocket_app_config.task_stack_caps). It
            runs the program's request handler and the calls made through
            m5_pocket_app_run_internal: flash operations such as NVS, FAT
            and Wi-Fi start, which a task with a PSRAM stack cannot make.

    config M5_POCKET_BRIDGE_SLOTS
        int "Bridge value slots"
        default 48
        help
            Distinct board -> app value names, including pointerX, pointerY
            and pointerDown when touch is configured.

    config M5_POCKET_BRIDGE_EVENTS
        int "Bridge event FIFO depth"
        default 16

    config M5_POCKET_BRIDGE_TEXT_MAX
        int "Longest text value in bytes"
        default 96

    config M5_POCKET_BRIDGE_ARRAY_MAX
        int "Longest array value in elements"
        default 256

    config M5_POCKET_APP_PROFILE
        bool "Frame profiler"
        default n
        select HEAP_USE_HOOKS
        help
            Times the stages of every frame on the app task (input poll,
            bridge, model, view update, draw list, damage plan, raster,
            flush, transfer wait) and counts the strips, rows and heap
            allocations of the frame. A task on core 0 logs one line per
            period and one line per slow frame with the tag m5_prof.

    config M5_POCKET_APP_PROFILE_PERIOD_MS
        int "Profiler report period in milliseconds"
        depends on M5_POCKET_APP_PROFILE
        default 1000

    config M5_POCKET_APP_PROFILE_SLOW_MS
        int "Report a frame that takes at least this many milliseconds"
        depends on M5_POCKET_APP_PROFILE
        default 100

endmenu
```

## tests/aot-smoke/sdkconfig.defaults
```kconfig
CONFIG_ESP_MAIN_TASK_STACK_SIZE=8192
CONFIG_COMPILER_OPTIMIZATION_PERF=y
CONFIG_FREERTOS_HZ=1000
CONFIG_PARTITION_TABLE_CUSTOM=y
CONFIG_PARTITION_TABLE_CUSTOM_FILENAME="partitions.csv"
CONFIG_ESPTOOLPY_FLASHSIZE_8MB=y
CONFIG_M5_POCKET_APP_MODE_JS=y
```
